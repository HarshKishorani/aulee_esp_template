## main/Kconfig.projbuild
```kconfig
menu "Provisioning Configuration"

    choice Wifi_PROV_TRANSPORT
        bool "Provisioning Transport"
        default PROV_TRANSPORT_SOFTAP if IDF_TARGET_ESP32S2
        default PROV_TRANSPORT_BLE
        help
            Wi-Fi provisioning component offers both, SoftAP and BLE transports. Choose any one.

        config PROV_TRANSPORT_BLE
            bool "BLE"
            select BT_ENABLED
            depends on !IDF_TARGET_ESP32S2
        config PROV_TRANSPORT_SOFTAP
            bool "Soft AP"
    endchoice

    config USE_PROTOCOMM_SECURITY_VERSION_1
        bool 
        default y
        prompt "Use Protocomm Security version 1 for Provision and Local Control."
        help
            Use Protocomm security version 1 for Prov and Local Control.

    config PROV_TRANSPORT
        int
        default 1 if PROV_TRANSPORT_BLE
        default 2 if PROV_TRANSPORT_SOFTAP

    config RESET_PROVISIONED
        bool
        default n
        prompt "Reset provisioned status of the device"
        help
            This erases the NVS to reset provisioned status of the device on every reboot.
            Provisioned status is determined by the Wi-Fi STA configuration, saved on the NVS.

    config RESET_PROV_MGR_ON_FAILURE
        bool
        default y
        prompt "Reset provisioned credentials and state machine after session failure"
        help
            Enable reseting provisioned credentials and state machine after session failure.
            This will restart the provisioning service after retries are exhausted.

    config PROV_MGR_MAX_RETRY_CNT
        int
        default 5
        prompt "Max retries before reseting provisioning state machine"
        depends on RESET_PROV_MGR_ON_FAILURE
        help
            Set the Maximum retry to avoid reconnecting to an inexistent AP or if credentials
            are misconfigured. Provisioned credentials are erased and internal state machine
            is reset after this threshold is reached.

    config PROV_SHOW_QR
        bool "Show provisioning QR code"
        default y
        help
            Show the QR code for provisioning.

    config PROV_USING_BLUEDROID
        bool
        depends on (BT_BLUEDROID_ENABLED && (IDF_TARGET_ESP32C3 || IDF_TARGET_ESP32S3))
        select BT_BLE_42_FEATURES_SUPPORTED
        default y
        help
            This enables BLE 4.2 features for Bluedroid.
endmenu
```
